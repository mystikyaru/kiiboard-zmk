## config/west.yml
```yaml
manifest:
  defaults:
    revision: v0.3
  remotes:
    - name: zmkfirmware
      url-base: https://github.com/zmkfirmware
    # Additional modules containing boards/shields/custom code can be listed here as well
    # See https://docs.zephyrproject.org/3.2.0/develop/west/manifest.html#projects
  projects:
    - name: zmk
      remote: zmkfirmware
      import: app/west.yml
    - name: kiiboard-zmk-shield-module
      url: https://github.com/mystikyaru/kiiboard-zmk-shield-module
      revision: main
      path: modules/kiiboard-zmk-shield-module
  self:
    path: config
```
